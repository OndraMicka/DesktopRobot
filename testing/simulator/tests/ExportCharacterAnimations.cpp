// Freeze the reviewed simulator frames into const firmware data. Run the exporter
// with esp32/src/display/animations/CharacterAnimationData.inc as its argument.
#include "animation/PreviewAnimations.h"
#include <fstream>
#include <map>
#include <sstream>
#include <vector>

int main(int argc,char** argv) {
    if(argc!=2) return 1;
    std::ofstream out(argv[1]);
    if(!out) return 1;
    const char* ids[]={"Microsleep","Hmm","Kiss","Sigh","SleepRoll","StartleLeft",
                       "StartleUpRight","HeavyLids","SleepyNod","SleepTwitch"};
    out<<"// Generated by testing/simulator/tests/ExportCharacterAnimations.cpp.\n"
          "// Approved pixel geometry and timing; const data resides in flash.\n";
    for(const auto& definition:desktoprobot::getPreviewDefinitions()) {
        const auto index=static_cast<std::size_t>(definition.id);
        const auto& animation=desktoprobot::getPreviewAnimation(definition.id);
        const char* name=ids[index];
        std::map<std::string,std::size_t> unique;
        std::vector<std::size_t> offsets;
        std::size_t commandOffset=0;
        out<<"constexpr PackedDrawCommand "<<name<<"Commands[]={\n";
        for(std::size_t i=0;i<animation.frameCount;++i) {
            const auto& frame=animation.frames[i];
            std::ostringstream signature;
            for(std::size_t j=0;j<frame.commandCount;++j) {
                const auto& c=frame.commands[j];
                for(const int value:{c.x1,c.y1,c.x2,c.y2,c.radius})
                    if(value < -128 || value > 127) return 2;
                signature<<'{'<<(int(c.type)|(c.filled ? 0x80:0))<<','
                    <<c.x1<<','<<c.y1<<','<<c.x2<<','<<c.y2<<','
                    <<c.radius<<"},\n";
            }
            const auto inserted=unique.emplace(signature.str(),commandOffset);
            offsets.push_back(inserted.first->second);
            if(inserted.second) {
                out<<signature.str(); commandOffset+=frame.commandCount;
            }
        }
        out<<"};\nconstexpr Frame "<<name<<"Frames[]={\n";
        for(std::size_t i=0;i<animation.frameCount;++i)
            out<<'{'<<animation.frames[i].durationMs<<",nullptr,"<<animation.frames[i].commandCount
                <<','<<name<<"Commands+"<<offsets[i]<<"},\n";
        std::string label=definition.label;
        if(label.rfind("NEW - ",0)==0) label=label.substr(6);
        out<<"};\nconstexpr Animation "<<name<<"Animation={\""<<label<<"\","
            <<name<<"Frames,"<<animation.frameCount<<",false};\n";
    }
    return out ? 0:1;
}
